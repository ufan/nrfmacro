/*
 * Copyright (c) 2020 The ZMK Contributors
 *
 * SPDX-License-Identifier: MIT
 */

#include "corne-pro.dtsi"

// setup kscan pins
&kscan {
	col-gpios
		= <&pro_micro  6 GPIO_ACTIVE_HIGH>
		, <&pro_micro  7 GPIO_ACTIVE_HIGH>
		, <&pro_micro  8 GPIO_ACTIVE_HIGH>
		, <&pro_micro  9 GPIO_ACTIVE_HIGH>
		, <&pro_micro 16 GPIO_ACTIVE_HIGH>
		, <&pro_micro 14 GPIO_ACTIVE_HIGH>
		;
};