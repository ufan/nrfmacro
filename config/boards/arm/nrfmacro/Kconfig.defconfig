## config/boards/arm/nrfmacro/Kconfig.defconfig
```kconfig
# Electronut Labs Papyr board configuration

# Copyright (c) 2020 The ZMK Contributors
# SPDX-License-Identifier: MIT

if BOARD_NRFMACRO

config BOARD
	default "nrfmacro"

choice
  prompt "nrfmacro Display option"
  default NRFMACRO_NO_DISPLAY
  help
    Specify the type of the display peripheral.

config NRFMACRO_NO_DISPLAY
  bool "No display screen"

config NRFMACRO_EPD_DISPLAY
  bool "Use epaper display"
  select SPI
  select IL0323
	select LVGL_USE_CONT
	select LVGL_FONT_MONTSERRAT_26
	select LVGL_FONT_MONTSERRAT_20
	select LVGL_FONT_MONTSERRAT_16
	select LVGL_USE_LABEL
	select LVGL_USE_IMG

config NRFMACRO_OLED_DISPLAY
  bool "Ues OLED display"
  select I2C
  select SSD1306
  select SSD1306_REVERSE_MODE

config NRFMACRO_LCD_DISPLAY
  bool "Use SHARP memory LCD"
  select SPI
  select LS0XX
	select LVGL_USE_CONT
	select LVGL_FONT_MONTSERRAT_26
	# select LVGL_FONT_MONTSERRAT_20
	# select LVGL_FONT_MONTSERRAT_16
	# select LVGL_USE_LABEL
	# select LVGL_USE_IMG

endchoice

if USB_DEVICE_STACK

config USB_NRFX
	default y

endif # USB_DEVICE_STACK

config BT_CTLR
	default BT

config ZMK_BLE
	default y

config ZMK_USB
	default y

if LVGL

if NRFMACRO_OLED_DISPLAY

config LVGL_HOR_RES_MAX
	default 128

config LVGL_VER_RES_MAX
	default 32

config LVGL_VDB_SIZE
	default 64

config LVGL_DPI
	default 148

config LVGL_BITS_PER_PIXEL
	default 1

choice LVGL_COLOR_DEPTH
	default LVGL_COLOR_DEPTH_1
endchoice

endif # NRFMACRO_OLED_DISPLAY

if NRFMACRO_EPD_DISPLAY

config LVGL_HOR_RES_MAX
	default 80

config LVGL_VER_RES_MAX
	default 128

config LVGL_VDB_SIZE
	default 100

config LVGL_DPI
	default 145

config LVGL_BITS_PER_PIXEL
	default 1

choice LVGL_COLOR_DEPTH
	default LVGL_COLOR_DEPTH_1
endchoice

config LVGL_USE_CONT
  default y

endif # NRFMACRO_EPD_DISPLAY

if NRFMACRO_LCD_DISPLAY

choice LVGL_THEME_DEFAULT_FONT_SMALL
    default LVGL_THEME_DEFAULT_FONT_SMALL_MONTSERRAT_36
endchoice

config LVGL_HOR_RES_MAX
	default 160

config LVGL_VER_RES_MAX
	default 68

config LVGL_VDB_SIZE
	default 16

config LVGL_DPI
	default 30

config LVGL_BITS_PER_PIXEL
	default 1

choice LVGL_COLOR_DEPTH
	default LVGL_COLOR_DEPTH_1
endchoice

endif # NRFMACRO_LCD_DISPLAY

endif # LVGL

menuconfig CUSTOM_WIDGET_BATTERY_STATUS
	bool "custom battery status widget"

menuconfig CUSTOM_WIDGET_OUTPUT_STATUS
	bool "custom output status widget"

menuconfig CUSTOM_WIDGET_LAYER_STATUS
	bool "custom layer status widget"

endif # BOARD_NRFMACRO
```

## config/boards/arm/nrfmacro/nrfmacro_defconfig
```kconfig
# SPDX-License-Identifier: MIT

CONFIG_BOARD_NRFMACRO=y

CONFIG_SOC_SERIES_NRF52X=y
CONFIG_SOC_NRF52840_QIAA=y

# Enable MPU
CONFIG_ARM_MPU=y

# enable GPIO
CONFIG_GPIO=y

CONFIG_USE_DT_CODE_PARTITION=y
CONFIG_BUILD_OUTPUT_UF2=y

CONFIG_MPU_ALLOW_FLASH_WRITE=y
CONFIG_NVS=y
CONFIG_SETTINGS_NVS=y
CONFIG_FLASH=y
CONFIG_FLASH_PAGE_LAYOUT=y
CONFIG_FLASH_MAP=y
CONFIG_CLOCK_CONTROL_NRF=y
CONFIG_CLOCK_CONTROL_NRF_K32SRC_RC=y

# # Turn on USB CDC ACM device
# CONFIG_USB=y
# CONFIG_USB_DEVICE_STACK=y
# CONFIG_USB_CDC_ACM=y
# CONFIG_USB_CDC_ACM_RINGBUF_SIZE=1024
# CONFIG_USB_CDC_ACM_DEVICE_NAME="CDC_ACM"
# CONFIG_USB_CDC_ACM_DEVICE_COUNT=1

# # Enable serial console
# CONFIG_SERIAL=y
# CONFIG_CONSOLE=y
# CONFIG_UART_INTERRUPT_DRIVEN=y
# CONFIG_UART_LINE_CTRL=y

# # Enable USB UART, and set the console device
# CONFIG_UART_CONSOLE=y
# CONFIG_USB_UART_CONSOLE=y
# CONFIG_UART_CONSOLE_ON_DEV_NAME="CDC_ACM_0"
```

## config/boards/shields/corne-pro/Kconfig.defconfig
```kconfig
# Copyright (c) 2020 The ZMK Contributors
# SPDX-License-Identifier: MIT

if CORNE_PRO_LEFT

config ZMK_KEYBOARD_NAME
	default "Corne-Pro"

config ZMK_SPLIT_BLE_ROLE_CENTRAL
	default y

endif

if CORNE_PRO_RIGHT
config ZMK_KEYBOARD_NAME
  default "Corne-Pro-R"

endif

if CORNE_PRO_LEFT || CORNE_PRO_RIGHT

config ZMK_SPLIT
	default y

config ZMK_USB
	default y

endif
```

## config/boards/shields/encodertest/Kconfig.defconfig
```kconfig
# Copyright (c) 2020 The ZMK Contributors
# SPDX-License-Identifier: MIT

if ENCODER_TEST_LEFT

config ZMK_KEYBOARD_NAME
	default "EncoderTest"

config ZMK_SPLIT_BLE_ROLE_CENTRAL
	default y

endif

if ENCODER_TEST_LEFT || ENCODER_TEST_RIGHT

config ZMK_SPLIT
	default y

endif
```

## config/boards/shields/encodertest/Kconfig.shield
```kconfig
# Copyright (c) 2020 The ZMK Contributors
# SPDX-License-Identifier: MIT

config ENCODER_TEST_LEFT
	def_bool $(shields_list_contains,encodertest_left)

config ENCODER_TEST_RIGHT
	def_bool $(shields_list_contains,encodertest_right)
```

## config/boards/shields/epdtest/Kconfig.defconfig
```kconfig
# Copyright (c) 2020 The ZMK Contributors
# SPDX-License-Identifier: MIT

if EPDTEST_LEFT

config ZMK_KEYBOARD_NAME
	default "EpdTest"

config ZMK_SPLIT_BLE_ROLE_CENTRAL
	default y

endif

if EPDTEST_LEFT || EPDTEST_RIGHT

config ZMK_SPLIT
	default y

endif
```

## config/boards/shields/epdtest/Kconfig.shield
```kconfig
# Copyright (c) 2020 The ZMK Contributors
# SPDX-License-Identifier: MIT

config EPDTEST_LEFT
	def_bool $(shields_list_contains,epdtest_left)

config EPDTEST_RIGHT
	def_bool $(shields_list_contains,epdtest_right)
```

## config/boards/shields/lcdtest/Kconfig.defconfig
```kconfig
# Copyright (c) 2020 The ZMK Contributors
# SPDX-License-Identifier: MIT

if LCDTEST_LEFT

config ZMK_KEYBOARD_NAME
	default "LCDTest"

config ZMK_SPLIT_BLE_ROLE_CENTRAL
	default y

endif

if LCDTEST_LEFT || LCDTEST_RIGHT

config ZMK_SPLIT
	default y

endif
```

## config/boards/shields/lcdtest/Kconfig.shield
```kconfig
# Copyright (c) 2020 The ZMK Contributors
# SPDX-License-Identifier: MIT

config LCDTEST_LEFT
	def_bool $(shields_list_contains,lcdtest_left)

config EPDTEST_RIGHT
	def_bool $(shields_list_contains,lcdtest_right)
```

## config/boards/shields/mixedtest/Kconfig.defconfig
```kconfig
# Copyright (c) 2020 The ZMK Contributors
# SPDX-License-Identifier: MIT

if MIXEDTEST_LEFT

config ZMK_KEYBOARD_NAME
	default "MixedTest"

config ZMK_SPLIT_BLE_ROLE_CENTRAL
	default y

endif

if MIXEDTEST_LEFT || MIXEDTEST_RIGHT

config ZMK_SPLIT
	default y

endif
```

## config/boards/shields/mixedtest/Kconfig.shield
```kconfig
# Copyright (c) 2020 The ZMK Contributors
# SPDX-License-Identifier: MIT

config MIXEDTEST_LEFT
	def_bool $(shields_list_contains,mixedtest_left)

config MIXEDTEST_RIGHT
	def_bool $(shields_list_contains,mixedtest_right)
```

## config/boards/shields/oledtest/Kconfig.defconfig
```kconfig
# Copyright (c) 2020 The ZMK Contributors
# SPDX-License-Identifier: MIT

if OLEDTEST_LEFT

config ZMK_KEYBOARD_NAME
	default "OLEDTest"

config ZMK_SPLIT_BLE_ROLE_CENTRAL
	default y

endif

if OLEDTEST_LEFT || OLEDTEST_RIGHT

config ZMK_SPLIT
	default y

endif
```

## config/boards/shields/oledtest/Kconfig.shield
```kconfig
# Copyright (c) 2020 The ZMK Contributors
# SPDX-License-Identifier: MIT

config OLEDTEST_LEFT
	def_bool $(shields_list_contains,oledtest_left)

config OLEDTEST_RIGHT
	def_bool $(shields_list_contains,oledtest_right)
```

## config/boards/shields/pdtest/Kconfig.defconfig
```kconfig
# Copyright (c) 2020 The ZMK Contributors
# SPDX-License-Identifier: MIT

if POINTDEVICE_TEST_LEFT

config ZMK_KEYBOARD_NAME
	default "PDTest"

config ZMK_SPLIT_BLE_ROLE_CENTRAL
	default y

endif

if POINTDEVICE_TEST_LEFT || POINTDEVICE_TEST_RIGHT

config ZMK_SPLIT
	default y

endif
```

## config/boards/shields/pdtest/Kconfig.shield
```kconfig
# Copyright (c) 2020 The ZMK Contributors
# SPDX-License-Identifier: MIT

config POINTDEVICE_TEST_LEFT
	def_bool $(shields_list_contains,pdtest_left)

config POINTDEVICE_TEST_RIGHT
	def_bool $(shields_list_contains,pdtest_right)
```

## config/boards/shields/shieldtest/Kconfig.defconfig
```kconfig
# Copyright (c) 2020 The ZMK Contributors
# SPDX-License-Identifier: MIT

if SHIELD_TEST_LEFT

config ZMK_KEYBOARD_NAME
	default "TestShield"

config ZMK_SPLIT_BLE_ROLE_CENTRAL
	default y

endif

if SHIELD_TEST_LEFT || SHIELD_TEST_RIGHT

config ZMK_SPLIT
	default y

endif
```

## config/boards/shields/shieldtest/Kconfig.shield
```kconfig
# Copyright (c) 2020 The ZMK Contributors
# SPDX-License-Identifier: MIT

config SHIELD_TEST_LEFT
	def_bool $(shields_list_contains,shieldtest_left)

config SHIELD_TEST_RIGHT
	def_bool $(shields_list_contains,shieldtest_right)
```

## config/boards/shields/sweepro-ce/Kconfig.defconfig
```kconfig
# Copyright (c) 2020 The ZMK Contributors
# SPDX-License-Identifier: MIT

if SWEEPRO_LEFT

config ZMK_KEYBOARD_NAME
	default "Sweep-Pro"

config ZMK_SPLIT_BLE_ROLE_CENTRAL
	default y

endif

if SWEEPRO_RIGHT
config ZMK_KEYBOARD_NAME
  default "Sweep-Pro-R"

endif

if SWEEPRO_LEFT || SWEEPRO_RIGHT

config ZMK_SPLIT
	default y

config ZMK_USB
	default y

endif
```

## config/boards/shields/sweepro/Kconfig.shield
```kconfig
# Copyright (c) 2020 The ZMK Contributors
# SPDX-License-Identifier: MIT

config SWEEPRO_LEFT
	def_bool $(shields_list_contains,sweepro_left)

config SWEEPRO_RIGHT
	def_bool $(shields_list_contains,sweepro_right)
```
